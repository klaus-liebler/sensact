## firmware/can-bus-monitor/main/Kconfig.projbuild
```kconfig
menu "Application Configuration"

    config WIFI_SSID
        string "WiFi SSID"
        default "myssid"
        help
            SSID (network name) for the example to connect to.

    config WIFI_PASSWORD
        string "WiFi Password"
        default "mypassword"
        help
            WiFi password (WPA or WPA2) for the example to use.

    config UDP_PORT
        int "Port number of UDP Broadcast"
        default 9876
        help
            Port number of UDP Broadcast.

endmenu
```

## firmware/sensactOutdoor/sensactIO_firmware/main/Kconfig.projbuild
```kconfig
menu "sensactio"
    config I2C_SLAVE_ADDRESS
        hex "I2C slave address"
        default 0x42
        help
            Set the I2C slave address.
    config HTTP_SCRATCHPAD_SIZE
        int "HTTP_SCRATCHPAD_SIZE"
        default 2048
        help
            All HTTP handlers (should) use a common buffer to process HTTP requests. This setting defines the size in bytes
    config OTA_URL
        string "OTA URL"
        default "https://www.google.de"
endmenu
```

## firmware/sensact_firmware/main/Kconfig.projbuild
```kconfig
menu "sensactHsNano"
    config HOSTNAME_PATTERN
        string "HOSTNAME Pattern"
        default "sensacths%02X%02X%02X"

    config MQTT_SERVER 
        string "MQTT Server"
        default "mqtt://test.mosquitto.org"

    config MQTT_PORT
        int "MQTT Port"
        default 1884

    config MQTT_USER
        string "MQTT Username"
        default "rw"

    config MQTT_PASS
        string "MQTT Password"
        default"readwrite"

    config MQTT_TOPIC
        string "MQTT Topic"
        default "de/klli/sensact"
    choice  BOARD
        prompt "BoardID"
        config SENSACT_BOARD_L0_HS0
            bool "SENSACT_BOARD_L0_HS0"
        config SENSACT_BOARD_L3_HS0
            bool "SENSACT_BOARD_L3_HS0"
    endchoice
endmenu


menu "Network (Ethernet/Wifi) Connection Configuration"

    config NETWORK_CONNECT_WIFI
        bool "connect using WiFi interface"
        default y
        help
            Protocol examples can use Wi-Fi and/or Ethernet to connect to the network.
            Choose this option to connect with WiFi

    if NETWORK_CONNECT_WIFI
        config NETWORK_WIFI_SSID
            string "WiFi SSID"
            default "smopla"
            help
                SSID (network name) for the example to connect to.

        config NETWORK_WIFI_PASSWORD
            string "WiFi Password"
            default "mypassword"
            help
                WiFi password (WPA or WPA2) for the example to use.
                Can be left blank if the network has no security set.

    endif

    config NETWORK_CONNECT_ETHERNET
        bool "connect using Ethernet interface"
        default n
        help
            Protocol examples can use Wi-Fi and/or Ethernet to connect to the network.
            Choose this option to connect with Ethernet

    if NETWORK_CONNECT_ETHERNET
        config NETWORK_USE_SPI_ETHERNET
            bool

        choice NETWORK_ETHERNET_TYPE
            prompt "Ethernet Type"
            default NETWORK_USE_INTERNAL_ETHERNET if IDF_TARGET_ESP32
            default NETWORK_USE_W5500
            help
                Select which kind of Ethernet will be used in the example.

            config NETWORK_USE_INTERNAL_ETHERNET
                depends on IDF_TARGET_ESP32
                select ETH_USE_ESP32_EMAC
                bool "Internal EMAC"
                help
                    Select internal Ethernet MAC controller.

            config NETWORK_USE_DM9051
                bool "DM9051 Module"
                select NETWORK_USE_SPI_ETHERNET
                select ETH_USE_SPI_ETHERNET
                select ETH_SPI_ETHERNET_DM9051
                help
                    Select external SPI-Ethernet module.

            config NETWORK_USE_W5500
                bool "W5500 Module"
                select NETWORK_USE_SPI_ETHERNET
                select ETH_USE_SPI_ETHERNET
                select ETH_SPI_ETHERNET_W5500
                help
                    Select external SPI-Ethernet module (W5500).

            config NETWORK_USE_OPENETH
                bool "OpenCores Ethernet MAC (EXPERIMENTAL)"
                select ETH_USE_OPENETH
                help
                    When this option is enabled, the example is built with support for
                    OpenCores Ethernet MAC, which allows testing the example in QEMU.
                    Note that this option is used for internal testing purposes, and
                    not officially supported. Examples built with this option enabled
                    will not run on a real ESP32 chip.

        endchoice # NETWORK_ETHERNET_TYPE

        if NETWORK_USE_INTERNAL_ETHERNET
            choice NETWORK_ETH_PHY_MODEL
                prompt "Ethernet PHY Device"
                default NETWORK_ETH_PHY_IP101
                help
                    Select the Ethernet PHY device to use in the example.

                config NETWORK_ETH_PHY_IP101
                    bool "IP101"
                    help
                        IP101 is a single port 10/100 MII/RMII/TP/Fiber Fast Ethernet Transceiver.
                        Goto http://www.icplus.com.tw/pp-IP101G.html for more information about it.

                config NETWORK_ETH_PHY_RTL8201
                    bool "RTL8201/SR8201"
                    help
                        RTL8201F/SR8201F is a single port 10/100Mb Ethernet Transceiver with auto MDIX.
                        Goto http://www.corechip-sz.com/productsview.asp?id=22 for more information about it.

                config NETWORK_ETH_PHY_LAN87XX
                    bool "LAN87xx"
                    help
                        Below chips are supported:
                        LAN8710A is a small footprint MII/RMII 10/100 Ethernet Transceiver with HP Auto-MDIX and
                            flexPWR® Technology.
                        LAN8720A is a small footprint RMII 10/100 Ethernet Transceiver with HP Auto-MDIX Support.
                        LAN8740A/LAN8741A is a small footprint MII/RMII 10/100 Energy Efficient Ethernet Transceiver
                            with HP Auto-MDIX and flexPWR® Technology.
                        LAN8742A is a small footprint RMII 10/100 Ethernet Transceiver with HP Auto-MDIX and
                            flexPWR® Technology.
                        Goto https://www.microchip.com for more information about them.

                config NETWORK_ETH_PHY_DP83848
                    bool "DP83848"
                    help
                        DP83848 is a single port 10/100Mb/s Ethernet Physical Layer Transceiver.
                        Goto http://www.ti.com/product/DP83848J for more information about it.
            endchoice

            config NETWORK_ETH_MDC_GPIO
                int "SMI MDC GPIO number"
                default 23
                help
                    Set the GPIO number used by SMI MDC.

            config NETWORK_ETH_MDIO_GPIO
                int "SMI MDIO GPIO number"
                default 18
                help
                    Set the GPIO number used by SMI MDIO.
        endif

        if NETWORK_USE_SPI_ETHERNET
            config NETWORK_ETH_SPI_HOST
                int "SPI Host Number"
                range 0 2
                default 1
                help
                    Set the SPI host used to communicate with the SPI Ethernet Controller.

            config NETWORK_ETH_SPI_SCLK_GPIO
                int "SPI SCLK GPIO number"
                range 0 33
                default 20
                help
                    Set the GPIO number used by SPI SCLK.

            config NETWORK_ETH_SPI_MOSI_GPIO
                int "SPI MOSI GPIO number"
                range 0 33
                default 19
                help
                    Set the GPIO number used by SPI MOSI.

            config NETWORK_ETH_SPI_MISO_GPIO
                int "SPI MISO GPIO number"
                range 0 33
                default 18
                help
                    Set the GPIO number used by SPI MISO.

            config NETWORK_ETH_SPI_CS_GPIO
                int "SPI CS GPIO number"
                range 0 33
                default 21
                help
                    Set the GPIO number used by SPI CS.

            config NETWORK_ETH_SPI_CLOCK_MHZ
                int "SPI clock speed (MHz)"
                range 20 80
                default 36
                help
                    Set the clock speed (MHz) of SPI interface.

            config NETWORK_ETH_SPI_INT_GPIO
                int "Interrupt GPIO number"
                default 4
                help
                    Set the GPIO number used by the SPI Ethernet module interrupt line.
        endif # NETWORK_USE_SPI_ETHERNET

        config NETWORK_ETH_PHY_RST_GPIO
            int "PHY Reset GPIO number"
            default 5
            help
                Set the GPIO number used to reset PHY chip.
                Set to -1 to disable PHY chip hardware reset.

        config NETWORK_ETH_PHY_ADDR
            int "PHY Address"
            range 0 31 if NETWORK_USE_INTERNAL_ETHERNET
            default 1
            help
                Set PHY address according your board schematic.
    endif # NETWORK_CONNECT_ETHERNET

    config NETWORK_CONNECT_IPV6
        bool "Obtain IPv6 address"
        default y
        depends on NETWORK_CONNECT_WIFI || NETWORK_CONNECT_ETHERNET
        select LWIP_IPV6
        help
            By default, examples will wait until IPv4 and IPv6 local link addresses are obtained.
            Disable this option if the network does not support IPv6.
            Choose the preferred IPv6 address type if the connection code should wait until other than
            the local link address gets assigned.
            Consider enabling IPv6 stateless address autoconfiguration (SLAAC) in the LWIP component.

    if NETWORK_CONNECT_IPV6
        choice NETWORK_CONNECT_PREFERRED_IPV6
            prompt "Preferred IPv6 Type"
            default NETWORK_CONNECT_IPV6_PREF_LOCAL_LINK
            help
                Select which kind of IPv6 address the connect logic waits for.

            config NETWORK_CONNECT_IPV6_PREF_LOCAL_LINK
                bool "Local Link Address"
                help
                    Blocks until Local link address assigned.

            config NETWORK_CONNECT_IPV6_PREF_GLOBAL
                bool "Global Address"
                help
                    Blocks until Global address assigned.

            config NETWORK_CONNECT_IPV6_PREF_SITE_LOCAL
                bool "Site Local Address"
                help
                    Blocks until Site link address assigned.

            config NETWORK_CONNECT_IPV6_PREF_UNIQUE_LOCAL
                bool "Unique Local Link Address"
                help
                    Blocks until Unique local address assigned.

        endchoice

    endif


endmenu
```
